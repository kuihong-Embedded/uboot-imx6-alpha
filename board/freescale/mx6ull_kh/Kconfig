## board/freescale/mx6ull_kh/Kconfig
```kconfig
if TARGET_MX6ULL_14X14_KH || TARGET_MX6ULL_9X9_EVK

config SYS_BOARD
	default "mx6ull_kh"

config SYS_VENDOR
	default "freescale"

config SYS_CONFIG_NAME
	default "mx6ull_kh"

endif
```
